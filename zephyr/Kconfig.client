## zephyr/Kconfig.client
```kconfig
# Copyright (c) 2021 Pelion.
# SPDX-License-Identifier: Apache-2.0

config PELION_ENDPOINT_TYPE
    string "Endpoint type name"
    default "default"
    help
      Optional name for the type of endpoint being connected. Useful for
      creating filters and organizing devices.

config PELION_LIFETIME
    int "Registration lifetime"
    range 60 4294967295
    default 86400
    help
      Interval in seconds between registration renewals. A device transitions
      from state "Registered" to "Deregistered" if the registration is not
      renewed within this lifetime interval. Recommended lifetime settings
      are in the range of multiple hours and days.

choice
    prompt "Transport mode (TCP/UDP/UDP Queue)"
    default PELION_TRANSPORT_MODE_UDP
    help
      Select transport protocol and mode: TCP, UDP, or UDP Queue

    config PELION_TRANSPORT_MODE_TCP
        bool "TCP"
        help
          Data is sent over TCP. Device actively listens for incoming messages.
          Recommended for applications that are always connected.

    config PELION_TRANSPORT_MODE_UDP
        bool "UDP"
        help
          Data is sent over UDP. Device actively listens for incoming messages.
          Recommended for low-bandwidth applications.

    config PELION_TRANSPORT_MODE_UDP_QUEUE
        bool "UDP Queue"
        help
          Data is sent over UDP. Messages sent to the device are queued up in
          the Cloud and only delivered immediately after the device renews
          its registration. Recommended for low-power, low-bandwidth
          applications that power downs between transmissions.

endchoice

config PELION_EVENT_LOOP_THREAD_STACK_SIZE
    int "Event loop thread stack size"
    default 8192
    help
      Stack size for the event loop thread.

config PELION_COAP_MAX_BLOCKWISE_PAYLOAD_SIZE
    int "Max CoAP blockwise payload size"
    default 512
    help
      Maximum payload size used by CoAP.

config PELION_DEBUG_TRACE
    bool "Build Pelion client with debug tracing"
    help
      Use debug tracing to observe Pelion client's internal workings.

config PELION_UPDATE
    bool "Enable firmware update"
    default y
    select BOOTLOADER_MCUBOOT
    select REBOOT
    help
      Build Pelion Client with support for firware update.

if PELION_UPDATE

    config PELION_UPDATE_PERMANENT
        bool "Instruct MCUboot to perform a permanent update instead of a test"
        help
          Marking new firmware as permanent is useful during the development phase
          where applications evolve rapidly.

    config PELION_UPDATE_COMPONENTS
        int "Maximum number of individually updateable components"
        default 1
        help
          Each component's name and version are reported to the Cloud and can be
          targeted in a firmware update campaign. First component (ID:0) is always
          labeled MAIN.

    config PELION_UPDATE_DEFAULT_APP_IFS
        bool "Use built-in application hooks for controlling update flow"
        default y
        help
          Use built-in functions for accepting new firmware and print out download
          progress. Disable built-in functions and provide custom appliction to
          control download flow and output download progress.

    config PELION_UPDATE_DEVELOPER
        bool "Automatically populate developer update credentials in secure storage"
        help
          For development purposes, the manifest creation tool can generate
          credentials useful during development (not production). Select this
          option for automatic insertion into the credential manager and add
          update_default_resources.c generated by the manifest tool to the build.

endif
```
